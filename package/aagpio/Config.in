## package/aagpio/Config.in
```kconfig
config BR2_PACKAGE_AAGPIO
	bool "aagpio"
	help
	  aagpio programm from task 3.1_Raspbian_Cross-compile
	  for task 3.2_Buildroot.Custom.
	  Aleksandr Afanasyev
```

## package/aahello/Config.in
```kconfig
config BR2_PACKAGE_AAHELLO
	bool "aahello"
	help
	  aahello programm from task 3.1_Raspbian_Cross-compile
	  for task 3.2_Buildroot.Custom.
	  Aleksandr Afanasyev
```
